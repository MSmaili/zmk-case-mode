## dts/bindings/behaviors/zmk,behavior-case-mode.yaml
```yaml
# Copyright (c) 2024 The ZMK Contributors
# SPDX-License-Identifier: MIT

description: |
  Case mode behavior. Intercepts space and replaces it with a configurable
  delimiter or capitalizes the next letter, enabling typing in various
  case styles (snake_case, camelCase, PascalCase, kebab-case, etc.).

compatible: "zmk,behavior-case-mode"
include: zero_param.yaml

properties:
  delimiter:
    type: int
    required: false
    default: 0
    description: |
      Keycode to emit when space is pressed (e.g. underscore, hyphen, dot).
      Use the default value only when emit-delimiter is false.
      When emit-delimiter is true, this must be set to a valid keyboard keycode.
  emit-delimiter:
    type: boolean
    required: false
    description: |
      Whether to emit the delimiter keycode on space. When false, space is
      swallowed (used for camelCase/PascalCase).
  capitalize-words:
    type: boolean
    required: false
    description: |
      Capitalize the first letter of each word (after space).
  capitalize-first:
    type: boolean
    required: false
    description: |
      Capitalize the very first letter after activation.
  capitalize-all:
    type: boolean
    required: false
    description: |
      Capitalize every letter (for SCREAMING styles).
  continue-list:
    type: array
    required: false
    description: |
      List of extra keycodes which do not deactivate case mode.
      Alpha characters (A-Z) are always included.
```
